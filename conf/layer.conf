## conf/layer.conf
```bitbake
# We have a conf and classes directory, add to BBPATH
BBPATH .= ":${LAYERDIR}"

# We have recipes-* directories, add to BBFILES
BBFILES += "${LAYERDIR}/recipes-*/*/*.bb \
	${LAYERDIR}/recipes-*/*/*.bbappend"

BBFILE_COLLECTIONS += "demo"
BBFILE_PATTERN_demo = "^${LAYERDIR}/"
BBFILE_PRIORITY_demo = "6"

LAYERSERIES_COMPAT_demo = "sumo"

LAYERDEPENDS_demo = "core openembedded-layer perl-layer networking-layer meta-python"
```

## meta-multiconfig/conf/layer.conf
```bitbake
# We have a conf and classes directory, add to BBPATH
BBPATH .= ":${LAYERDIR}"

# We have recipes-* directories, add to BBFILES
BBFILES += "${LAYERDIR}/recipes-*/*/*.bb \
	${LAYERDIR}/recipes-*/*/*.bbappend"

BBFILE_COLLECTIONS += "multik"
BBFILE_PATTERN_multik = "^${LAYERDIR}/"
BBFILE_PRIORITY_multik = "6"

LAYERSERIES_COMPAT_multik = "thud"

#LAYERDEPENDS_demo = "core openembedded-layer perl-layer networking-layer meta-python"
```
